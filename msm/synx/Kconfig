## msm/synx/Kconfig
```kconfig
# Copyright (c) Qualcomm Technologies, Inc. and/or its subsidiaries.


menuconfig MSM_GLOBAL_SYNX
	tristate "Qualcomm Technologies, Inc. Global Synchronization Framework"
	depends on ARCH_QCOM
	help
	  Say M here to enable global synchronization module for
	  Qualcomm Technologies, Inc. chipsets.
	  Enabling this adds support for global synchronization across
	  heterogeneous cores.
```
